## meta-dstack-nvidia/meta-dstack/conf/distro/dstack.conf
```bitbake
require conf/distro/cvm.conf
DISTRO = "dstack"
DISTRO_NAME = "DStack"
DISTRO_FEATURES:append = " virtualization seccomp systemd usrmerge security dm-verity ipv6"
DISTRO_FEATURES_BACKFILL_CONSIDERED += "sysvinit"

DISTRO_VERSION = "0.5.4"
DISTROOVERRIDES = "poky:dstack"
INITRAMFS_IMAGE = ""
VOLATILE_LOG_DIR = "no"
VOLATILE_TMP_DIR = "yes"

PREFERRED_PROVIDER_virtual/kernel = "linux-yocto-dev"
PREFERRED_VERSION_linux-yocto-dev ?= "6.9%"
LINUX_KERNEL_TYPE = "tiny"

MACHINE_FEATURES += "numa"

VIRTUAL-RUNTIME_init_manager = "systemd"
VIRTUAL-RUNTIME_initscripts = ""
VIRTUAL-RUNTIME_dev_manager = "systemd"

SERIAL_CONSOLES = "115200;ttyS0"
PREFERRED_VERSION_rust-bin-cross-x86_64 = "1.86.0"
PREFERRED_VERSION_cargo-bin-cross-x86_64 = "1.86.0"

BAD_RECOMMENDATIONS = "busybox-syslog systemd-extra-utils"
```

## meta-dstack/conf/distro/dstack.conf
```bitbake
require conf/distro/cvm.conf
DISTRO = "dstack"
DISTRO_NAME = "DStack"
DISTRO_FEATURES:append = " virtualization seccomp systemd usrmerge"
DISTRO_FEATURES_BACKFILL_CONSIDERED += "sysvinit"

DISTRO_VERSION = "0.5.0"
DISTROOVERRIDES = "poky:dstack"
INITRAMFS_IMAGE = ""
VOLATILE_LOG_DIR = "no"
VOLATILE_TMP_DIR = "yes"

PREFERRED_PROVIDER_virtual/kernel = "linux-yocto-dev"
PREFERRED_VERSION_linux-yocto-dev ?= "6.9%"

VIRTUAL-RUNTIME_init_manager = "systemd"
VIRTUAL-RUNTIME_initscripts = ""
VIRTUAL-RUNTIME_dev_manager = "systemd"
```
